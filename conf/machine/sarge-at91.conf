## conf/machine/sarge-at91.conf
```bitbake
#@TYPE: Machine
#@Name: Sarge AT91RM9200 blackmesaeast dev boards
#@DESCRIPTION: Machine configuration for sarge_at91 dev boards
#
#Homepage: http://blackmesaeast.com.pl/projects/electronics/sarge-single-board-computer/

TARGET_ARCH = "arm"

# used by sysvinit_2
SERIAL_CONSOLE = "115200 ttyS0"

IMAGE_FSTYPES = "jffs2 tar.gz ext2"

MACHINE_FEATURES = "kernel30 usbhost usbgadget mmc vfat ext2 bluetooth wifi pcmcia apm gps"
MACHINE_EXTRA_RRECOMMENDS += "kernel-modules"

require ${COREBASE}/meta/conf/machine/include/tune-arm920t.inc

PREFERRED_PROVIDER_virtual/kernel ?= "linux"

# device has own patchset for u-boot 1.1.6
PREFERRED_VERSION_u-boot = "1.1.6"
PREFERRED_VERSION_linux  = "3.2"

KERNEL_IMAGETYPE = "uImage"

UBOOT_LOADADDRESS = "0x20008000"
UBOOT_ENTRYPOINT  = "0x20008000"
UBOOT_MACHINE     = "sarge_config"
```
